## sdkconfig.defaults
```kconfig
# Target
CONFIG_IDF_TARGET="esp32s3"

# Flash
CONFIG_ESPTOOLPY_FLASHSIZE_16MB=y
CONFIG_ESPTOOLPY_FLASHSIZE="16MB"

# PSRAM (Octal SPI, 80 MHz — XIAO ESP32-S3 Plus has 8 MB PSRAM)
CONFIG_SPIRAM=y
CONFIG_SPIRAM_MODE_OCT=y
CONFIG_SPIRAM_SPEED_80M=y
CONFIG_SPIRAM_TYPE_AUTO=y

# Partition table
CONFIG_PARTITION_TABLE_CUSTOM=y
CONFIG_PARTITION_TABLE_CUSTOM_FILENAME="partitions.csv"

# NimBLE (preferred over BlueDroid for lower footprint)
CONFIG_BT_ENABLED=y
CONFIG_BT_NIMBLE_ENABLED=y
CONFIG_BT_NIMBLE_ROLE_PERIPHERAL=y
CONFIG_BT_NIMBLE_ROLE_CENTRAL=n
CONFIG_BT_NIMBLE_ROLE_OBSERVER=n
CONFIG_BT_NIMBLE_ROLE_BROADCASTER=n
CONFIG_BT_NIMBLE_MAX_CONNECTIONS=2

# WiFi
CONFIG_ESP_WIFI_SOFTAP_SUPPORT=y

# OTA — allow plain HTTP (workbench serves over HTTP)
CONFIG_ESP_HTTPS_OTA_ALLOW_HTTP=y

# DHCP captive portal support
CONFIG_LWIP_DHCPS=y
CONFIG_ESP_ENABLE_DHCP_CAPTIVEPORTAL=y

# Log level
CONFIG_LOG_DEFAULT_LEVEL_INFO=y
```
